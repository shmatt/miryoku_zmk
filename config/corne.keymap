// Copyright 2021 Manna Harbour
// https://github.com/manna-harbour/miryoku

#include "../miryoku/custom_config.h"
#include "../miryoku/mapping/42/corne.h"
#include "../miryoku/miryoku.dtsi"

#if defined (MIRYOKU_KLUDGE_JOYCON2)
// Joy-Con 2 controller support (github.com/shmatt/zmk-joycon2). Inert unless
// MIRYOKU_KLUDGE_JOYCON2 is defined, so builds without it are unaffected.
#include <joycon2.dtsi>

/ {
  combos {
    compatible = "zmk,combos";

    // Left-half OUTER thumb pair: start a scan, then hold SYNC on a
    // controller to connect it. Press again to add the second half.
    combo_joycon2_connect {
      timeout-ms = <50>;
      key-positions = <36 37>;
      bindings = <&joycon2_connect>;
    };

    // Left-half INNER thumb pair: toggle the module's debug output, which
    // types through the keyboard's own HID connection and is off by default.
    combo_joycon2_log {
      timeout-ms = <50>;
      key-positions = <37 38>;
      bindings = <&joycon2_debug_print 0>;
    };
  };
};
#endif
